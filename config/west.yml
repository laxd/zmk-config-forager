## config/west.yml
```yaml
manifest:
  remotes:
    - name: zmkfirmware
      url-base: https://github.com/zmkfirmware
    - name: carrefinho
      url-base: https://github.com/carrefinho
    - name: caksoylar
      url-base: https://github.com/caksoylar
  projects:
    - name: zmk
      remote: zmkfirmware
      revision: main
      import: app/west.yml
    - name: forager-zmk-module
      remote: carrefinho
      revision: main
    - name: prospector-zmk-module
      remote: carrefinho
      revision: main
    - name: forager-zmk-module-dongle
      remote: carrefinho
      revision: main

    - name: zmk-rgbled-widget
      remote: caksoylar
      revision: main
  self:
    path: config
```
